## drivers/ec/Kconfig
```kconfig
config EC
    tristate "EC"
    help
       EC driver.




config EC_I2C_DRIVER
    tristate "EC I2C Driver"
    depends on I2C
    depends on EC
    help
      This is a driver for communicating with EC devices via I2C bus.
      
      To compile this driver as a module, choose M here.
      If unsure, say N.
```

## drivers/light/light_bsp/Kconfig
```kconfig
# SPDX-License-Identifier: GPL-2.0-only
#
config LIGHT_BSP
	tristate "light bsp driver"
	help
	  This is light bsp driver.

if LIGHT_BSP
config LIGHT_SWITCH_GPIO
        tristate "light switch gpio driver"
	help
          This driver provides support for light switch for gpio.
endif
```

## drivers/net/wireless/aic8800/aic8800_bsp/Kconfig
```kconfig
config AIC8800_WLAN_BSP_SUPPORT
	tristate "AIC8800 wlan BSP Support"
	help
	  This is support for aic wifi BSP PACKET.
```

## drivers/net/wireless/aic8800/aic8800_fdrv/Kconfig
```kconfig
config AIC8800_WLAN_SUPPORT
	tristate "AIC8800 wlan Support"
	depends on AIC8800_WLAN_BSP_SUPPORT
	help
	  This is support for aic wifi driver.
```
